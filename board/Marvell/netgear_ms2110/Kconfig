## board/Marvell/netgear_ms2110/Kconfig
```kconfig
if TARGET_NETGEAR_MS2110

config SYS_BOARD
	default "netgear_ms2110"

config SYS_VENDOR
	default "Marvell"

config SYS_CONFIG_NAME
	default "netgear_ms2110"

endif
```

## board/Seagate/goflexnet/Kconfig
```kconfig
if TARGET_GOFLEXNET

config SYS_BOARD
	default "goflexnet"

config SYS_VENDOR
	default "Seagate"

config SYS_CONFIG_NAME
	default "goflexnet"

endif
```

## board/cloudengines/pogo_v4/Kconfig
```kconfig
if TARGET_POGO_V4

config SYS_BOARD
	default "pogo_v4"

config SYS_VENDOR
	default "cloudengines"

config SYS_CONFIG_NAME
	default "pogo_v4"

endif
```

## board/hp/t5325/Kconfig
```kconfig
# 
# (C) Copyright 2016 bodhi <mibodhi@gmail.com>
#
#
if TARGET_T5325

config SYS_BOARD
	default "t5325"

config SYS_VENDOR
	default "hp"

config SYS_CONFIG_NAME
	default "t5325"

endif
```

## board/medion/md86783/Kconfig
```kconfig
#
# Copyright (C) 2019	Damien Merenne <dmerenne@gmail.com>
#
# SPDX-License-Identifier:	GPL-2.0+
#

if TARGET_MD86783

config SYS_BOARD
	default "md86783"

config SYS_VENDOR
	default "medion"

config SYS_CONFIG_NAME
	default "md86783"

endif
```

## board/netgear/readynas_duo_v2/Kconfig
```kconfig
if TARGET_READYNAS_DUO_V2

config SYS_BOARD
	default "readynas_duo_v2"

config SYS_VENDOR
	default "netgear"

config SYS_CONFIG_NAME
	default "readynas_duo_v2"

endif
```

## board/qnap/ts219p/Kconfig
```kconfig
if TARGET_TS219P

config SYS_BOARD
	default "ts219p"

config SYS_VENDOR
	default "qnap"

config SYS_CONFIG_NAME
	default "ts219p"

endif
```

## board/zyxel/nsa310/Kconfig
```kconfig
if TARGET_NSA310

config SYS_BOARD
	default "nsa310"

config SYS_VENDOR
	default "zyxel"

config SYS_CONFIG_NAME
	default "nsa310"

endif
```

## board/zyxel/nsa310s/Kconfig
```kconfig
if TARGET_NSA310S

config SYS_BOARD
	default "nsa310s"

config SYS_VENDOR
	default "zyxel"

config SYS_CONFIG_NAME
	default "nsa310s"

endif
```

## board/zyxel/nsa320/Kconfig
```kconfig
if TARGET_NSA320

config SYS_BOARD
	default "nsa320"

config SYS_VENDOR
	default "zyxel"

config SYS_CONFIG_NAME
	default "nsa320"

endif
```

## configs/iconnect_defconfig
```kconfig
#
# (C) Copyright 2017 bodhi <mibodhi@gmail.com>
#
CONFIG_ARM=y
CONFIG_KIRKWOOD=y
CONFIG_TARGET_ICONNECT=y
CONFIG_IDENT_STRING="\nIomega iConnect"
CONFIG_HUSH_PARSER=y
# CONFIG_DISPLAY_BOARDINFO is not set
CONFIG_SYS_PROMPT="iConnect> "
# CONFIG_CMD_IMLS is not set
# CONFIG_CMD_FLASH is not set
CONFIG_CMD_BOOTZ=y
CONFIG_CMD_USB=y
CONFIG_CMD_SETEXPR=y
CONFIG_CMD_DHCP=y
CONFIG_CMD_MII=y
CONFIG_CMD_PING=y
CONFIG_CMD_EXT2=y
CONFIG_CMD_FAT=y
CONFIG_CMD_JFFS2=y
CONFIG_CMD_UBI=y
CONFIG_ISO_PARTITION=y
CONFIG_EFI_PARTITION=y
CONFIG_CMD_GPT=y
CONFIG_PARTITION_TYPE_GUID=y
# CONFIG_MMC is not set
CONFIG_SYS_NS16550=y
CONFIG_USB=y
CONFIG_USB_EHCI_HCD=y
CONFIG_USB_STORAGE=y
CONFIG_LZMA=y
CONFIG_OF_LIBFDT=y
CONFIG_CMD_FDT=y
```

## configs/md86783_defconfig
```kconfig
#
# (C) Copyright 2019 Damien Merenne <dmerenne@gmail.com>
#
CONFIG_ARM=y
CONFIG_AHCI=y
CONFIG_KIRKWOOD=y
CONFIG_TARGET_MD86783=y
CONFIG_SYS_PROMPT="MD86783> "
CONFIG_IDENT_STRING="\nMEDION MD86873 2-Bay Network Drive"
CONFIG_HUSH_PARSER=y
CONFIG_CONSOLE_MUX=y
CONFIG_CMD_BOOTZ=y
# CONFIG_DISPLAY_BOARDINFO is not set
# CONFIG_CMD_IMLS is not set
CONFIG_CMD_IDE=y
# CONFIG_CMD_FLASH is not set
CONFIG_CMD_USB=y
CONFIG_CMD_SETEXPR=y
CONFIG_CMD_DHCP=y
CONFIG_CMD_MII=y
CONFIG_CMD_PING=y
CONFIG_CMD_EXT2=y
CONFIG_CMD_FAT=y
CONFIG_CMD_JFFS2=y
CONFIG_CMD_UBI=y
CONFIG_ISO_PARTITION=y
CONFIG_EFI_PARTITION=y
CONFIG_CMD_GPT=y
CONFIG_PARTITION_TYPE_GUID=y
# CONFIG_MMC is not set
CONFIG_SYS_NS16550=y
CONFIG_USB=y
CONFIG_USB_EHCI_HCD=y
CONFIG_USB_STORAGE=y
CONFIG_LZMA=y
CONFIG_OF_LIBFDT=y
CONFIG_CMD_FDT=y
```

## configs/netgear_ms2110_defconfig
```kconfig
CONFIG_ARM=y
CONFIG_KIRKWOOD=y
CONFIG_TARGET_NETGEAR_MS2110=y
CONFIG_SYS_PROMPT="Netgear_MS2110> "
# CONFIG_CMD_IMLS is not set
# CONFIG_CMD_FLASH is not set
CONFIG_CMD_SETEXPR=y
```

## configs/nsa310s_defconfig
```kconfig
CONFIG_ARM=y
CONFIG_KIRKWOOD=y
CONFIG_TARGET_NSA310S=y
CONFIG_SYS_PROMPT="NSA3x0S> "
# CONFIG_CMD_IMLS is not set
# CONFIG_CMD_FLASH is not set
CONFIG_CMD_SETEXPR=y
```

## configs/nsa320_defconfig
```kconfig
CONFIG_ARM=y
CONFIG_KIRKWOOD=y
CONFIG_TARGET_NSA320=y
CONFIG_SYS_PROMPT="NSA320> "
# CONFIG_CMD_IMLS is not set
# CONFIG_CMD_FLASH is not set
CONFIG_CMD_SETEXPR=y
```

## configs/nsa325_defconfig
```kconfig
CONFIG_ARM=y
CONFIG_KIRKWOOD=y
CONFIG_TARGET_NSA325=y
CONFIG_SYS_PROMPT="NSA325> "
# CONFIG_CMD_IMLS is not set
# CONFIG_CMD_FLASH is not set
CONFIG_CMD_SETEXPR=y
```

## configs/pogo_v4_defconfig
```kconfig
CONFIG_ARM=y
CONFIG_KIRKWOOD=y
CONFIG_TARGET_POGO_V4=y
CONFIG_SYS_PROMPT="Pogo_V4> "
# CONFIG_CMD_IMLS is not set
# CONFIG_CMD_FLASH is not set
CONFIG_CMD_SETEXPR=y
```

## configs/readynas_duo_v2_defconfig
```kconfig
#
# (C) Copyright 2021 ingmar-k <ingmar_klein@web.de>
#
CONFIG_ARM=y
CONFIG_KIRKWOOD=y
CONFIG_TARGET_READYNAS_DUO_V2=y
CONFIG_SYS_PROMPT="READYNAS_DUO_V2> "
CONFIG_IDENT_STRING="\nNETGEAR READYNAS DUO V2"
CONFIG_HUSH_PARSER=y
CONFIG_SYS_HUSH_PARSER=y
# CONFIG_DISPLAY_BOARDINFO is not set
# CONFIG_CMD_IMLS is not set
CONFIG_CMD_IDE=y
# CONFIG_CMD_FLASH is not set
CONFIG_CMD_I2C=y
CONFIG_SYS_I2C_SPEED_MAX=10000
CONFIG_SYS_I2C_SPEED=10000
CONFIG_CMD_BOOTZ=y
CONFIG_CMD_USB=y
CONFIG_CMD_SETEXPR=y
CONFIG_CMD_DHCP=y
CONFIG_CMD_MII=y
CONFIG_CMD_PING=y
CONFIG_CMD_EXT2=y
CONFIG_CMD_EXT4=y
CONFIG_CMD_FAT=y
CONFIG_CMD_JFFS2=y
CONFIG_CMD_UBI=y
CONFIG_ISO_PARTITION=y
CONFIG_EFI_PARTITION=y
CONFIG_CMD_GPT=y
CONFIG_PARTITION_TYPE_GUID=y
# CONFIG_MMC is not set
CONFIG_SYS_NS16550=y
CONFIG_USB=y
CONFIG_USB_STORAGE=y
CONFIG_USB_EHCI_HCD=y
CONFIG_OF_LIBFDT=y
CONFIG_CMD_FDT=y
```

## configs/t5325_defconfig
```kconfig
#
# (C) Copyright 2016-2017 bodhi <mibodhi@gmail.com>
#
CONFIG_ARM=y
CONFIG_KIRKWOOD=y
CONFIG_TARGET_T5325=y
CONFIG_SYS_PROMPT="T5325> "
CONFIG_IDENT_STRING="\nHP Thin Client T5325"
# CONFIG_DISPLAY_BOARDINFO is not set
CONFIG_HUSH_PARSER=y
# CONFIG_CMD_IMLS is not set
CONFIG_CMD_IDE=y
# CONFIG_CMD_FLASH is not set
CONFIG_CMD_BOOTZ=y
CONFIG_CMD_USB=y
CONFIG_CMD_SETEXPR=y
CONFIG_CMD_DHCP=y
CONFIG_CMD_MII=y
CONFIG_CMD_PING=y
CONFIG_CMD_EXT2=y
CONFIG_CMD_EXT4=y
CONFIG_CMD_FAT=y
CONFIG_CMD_UBI=y
CONFIG_ISO_PARTITION=y
CONFIG_EFI_PARTITION=y
CONFIG_CMD_GPT=y
CONFIG_PARTITION_TYPE_GUID=y
CONFIG_SPI_FLASH=y
CONFIG_SPI_FLASH_STMICRO=y
CONFIG_SPI_FLASH_ATMEL=y
CONFIG_SPI_FLASH_EON=y
CONFIG_SPI_FLASH_GIGADEVICE=y
CONFIG_SPI_FLASH_MACRONIX=y
CONFIG_SPI_FLASH_SPANSION=y
CONFIG_SPI_FLASH_SST=y
CONFIG_SPI_FLASH_WINBOND=y
# CONFIG_SPI_FLASH_USE_4K_SECTORS is not set
CONFIG_CMD_SPI=y
CONFIG_SYS_NS16550=y
CONFIG_USB=y
CONFIG_USB_STORAGE=y
CONFIG_USB_EHCI_HCD=y
CONFIG_OF_LIBFDT=y
CONFIG_CMD_FDT=y
```

## configs/ts219p_defconfig
```kconfig
CONFIG_ARM=y
CONFIG_KIRKWOOD=y
CONFIG_TARGET_TS219P=y
CONFIG_SYS_PROMPT="TS219P> "
# CONFIG_CMD_IMLS is not set
# CONFIG_CMD_FLASH is not set
CONFIG_CMD_FDT=y
CONFIG_OF_LIBFDT=y
CONFIG_CMD_SETEXPR=y
```
